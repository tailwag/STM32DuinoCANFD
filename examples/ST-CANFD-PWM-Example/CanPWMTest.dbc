VERSION ""

NS_ :

BS_:

BU_:

BO_ 512 STtoPC: 8 Vector__XXX
 SG_ DutyCycle : 32|32@1- (1,0) [-3.4E+38|3.4E+38] "%" Vector__XXX
 SG_ Frequency : 0|32@1- (1,0) [-3.4E+38|3.4E+38] "Hz" Vector__XXX

BO_ 256 PCtoST: 8 Vector__XXX
 SG_ DutyCycle : 32|32@1- (1,0) [-3.4E+38|3.4E+38] "%" Vector__XXX
 SG_ Frequency : 0|32@1- (1,0) [-3.4E+38|3.4E+38] "Hz" Vector__XXX

BA_DEF_ BO_  "CANFD_BRS" ENUM  "0","1";
BA_DEF_  "DBName" STRING ;
BA_DEF_  "BusType" STRING ;
BA_DEF_ BO_  "VFrameFormat" ENUM  "StandardCAN","ExtendedCAN","reserved","reserved","reserved","reserved","reserved","reserved","reserved","reserved","reserved","reserved","reserved","reserved","StandardCAN_FD","ExtendedCAN_FD";
BA_DEF_DEF_  "CANFD_BRS" "1";
BA_DEF_DEF_  "DBName" "";
BA_DEF_DEF_  "BusType" "";
BA_DEF_DEF_  "VFrameFormat" "StandardCAN";
BA_ "BusType" "CAN FD";
BA_ "DBName" "CanPWMTest";
BA_ "VFrameFormat" BO_ 512 14;
BA_ "VFrameFormat" BO_ 256 14;
SIG_VALTYPE_ 512 DutyCycle : 1;
SIG_VALTYPE_ 512 Frequency : 1;
SIG_VALTYPE_ 256 DutyCycle : 1;
SIG_VALTYPE_ 256 Frequency : 1;
